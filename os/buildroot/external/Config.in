## os/buildroot/external/Config.in
```kconfig
source "$BR2_EXTERNAL_MCOS_PATH/package/mcos/Config.in"
source "$BR2_EXTERNAL_MCOS_PATH/package/nerd-font/Config.in"
```

## os/buildroot/external/package/mcos/Config.in
```kconfig
config BR2_PACKAGE_MCOS
	bool "mcos"
	help
	  MCOS daemon and panel binaries for the Minecraft Server OS.
	  Includes mcosd, mcosctl, mcos-panel, mcos-detect.
```

## os/buildroot/external/package/nerd-font/Config.in
```kconfig
config BR2_PACKAGE_NERD_FONT
	bool "nerd-font"
	help
	  Installs a patched Nerd Font (FiraCode) for modern TUI icons.
```
